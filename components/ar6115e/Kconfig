## components/ar6115e/Kconfig
```kconfig
menu "AR6115e Configuration"

# This is actually also handled in the ESP32 startup code, not only in FreeRTOS.
config AR6115_USE_DEBUG_SERVICE
    bool "Enable Network Debug"
    default n
    help
        Enable debug over server socket.

config AR6115_DEBUG_PORT
    int "Port Number"
    depends on AR6115_USE_DEBUG_SERVICE
    default 9001
    help
        Port number for debug service to listen.

endmenu
```

## components/mpu9250_dmp/Kconfig
```kconfig
menu "MPU9250 IMU Configuration"

# This is actually also handled in the ESP32 startup code, not only in FreeRTOS.
choice MPU9250_DEFAULT_ADDRESS
    prompt "I2C device address"
    default MPU9250_DEFAULT_ADDRESS_0X68
    help
        I2C device address for IMU.

config MPU9250_DEFAULT_ADDRESS_0X68
    bool "0x68"
config MPU9250_DEFAULT_ADDRESS_0X69
    bool "0x69"
endchoice

config MPU9250_DEFAULT_ADDRESS
    hex
    default 0x68 if MPU9250_DEFAULT_ADDRESS_0X68
    default 0x69 if MPU9250_DEFAULT_ADDRESS_0X69

config MPU9250_DMP_RATE
    int "DMP FIFO Rate (hz)"
    default 200
    range 1 200
    help
        DMP update rate for FIFO buffer in hz.  Valid options: 1 - 200

config MPU9250_USE_DEBUG_SERVICE
    bool "Enable Network Debug"
    default n
    help
        Enable debug over server socket.

config MPU9250_DEBUG_PORT
    int "Port Number"
    depends on MPU9250_USE_DEBUG_SERVICE
    default 9001
    help
        Port number for debug service.


endmenu
```

## components/qrobot/Kconfig
```kconfig
menu "QRobot Configuration"

# This is actually also handled in the ESP32 startup code, not only in FreeRTOS.
config QROBOT_USE_DEBUG_SERVICE
    bool "Enable Network Debug"
    default n
    help
        Enable debug over server socket.

config QROBOT_DEBUG_PORT
    int "Port Number"
    depends on QROBOT_USE_DEBUG_SERVICE
    default 9000
    help
        Port number for debug service to listen.

endmenu
```

## main/Kconfig
```kconfig
menu "WiFi AP Configuration"

config WIFI_HOST_AP_MODE
    bool "Use as Host AP"
config WIFI_HOST_AP_SSID
    string "SSID of access point" if WIFI_HOST_AP_MODE
config WIFI_HOST_AP_PASSWORD
    string "Password of access point" if WIFI_HOST_AP_MODE
config WIFI_HOST_AP_CHANNEL
    int "Channel" if WIFI_HOST_AP_MODE
config WIFI_HOST_AP_MAX_CONNECTIONS
    int "Maximum connections" if WIFI_HOST_AP_MODE
    
config WIFI_AP1
    bool "Set access point 1" if !WIFI_HOST_AP_MODE
config WIFI_AP1_SSID
    string "SSID of access point 1" if WIFI_AP1
config WIFI_AP1_PASSWORD
    string "Password of access point 1" if WIFI_AP1

config WIFI_AP2
    bool "Set access point 2" if WIFI_AP1
config WIFI_AP2_SSID
    string "SSID of access point 1" if WIFI_AP2
config WIFI_AP2_PASSWORD
    string "Password of access point 1" if WIFI_AP2


config WIFI_AP3
    bool "Set access point 3" if WIFI_AP2
config WIFI_AP3_SSID
    string "SSID of access point 1" if WIFI_AP3
config WIFI_AP3_PASSWORD
    string "Password of access point 1" if WIFI_AP3


config WIFI_AP4
    bool "Set access point 4" if WIFI_AP3
config WIFI_AP4_SSID
    string "SSID of access point 1" if WIFI_AP4
config WIFI_AP4_PASSWORD
    string "Password of access point 1" if WIFI_AP4


config WIFI_AP5
    bool "Set access point 5" if WIFI_AP4
config WIFI_AP5_SSID
    string "SSID of access point 1" if WIFI_AP5
config WIFI_AP5_PASSWORD
    string "Password of access point 1" if WIFI_AP5

config WIFI_AP_COUNT
    int "Number of access points configured" if !WIFI_HOST_AP_MODE
    range 0 5
    default 5 if WIFI_AP5
    default 4 if WIFI_AP4
    default 3 if WIFI_AP3
    default 2 if WIFI_AP2
    default 1 if WIFI_AP1
    default 0

endmenu
```
